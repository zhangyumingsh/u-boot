// SPDX-License-Identifier: (GPL-2.0+ OR MIT)
/*
 * (C) Copyright 2022 BigtreeTech Computer Tech. Co., Ltd.
 * 
 *
 * Copyright (c) 2021 Rockchip Electronics Co., Ltd
 */

/dts-v1/;
#include "rk3588.dtsi"
#include "rk3588-u-boot.dtsi"
#include <dt-bindings/input/input.h>

/ {
    model = "BigtreeTech boards based on Rockchip RK3588";
    compatible = "bigtreetech,pi3",
             "rockchip,rk3588";
};
